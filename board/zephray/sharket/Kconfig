## board/zephray/sharket/Kconfig
```kconfig
if TARGET_SHARKET

config SYS_BOARD
	default "sharket"

config SYS_VENDOR
	default "zephray"

config SYS_CONFIG_NAME
	default "sharket"

source "board/freescale/common/Kconfig"

endif
```
